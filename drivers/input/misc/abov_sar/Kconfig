## drivers/input/misc/abov_sar/Kconfig
```kconfig
#
# SAR Sensor driver
#

config ABOV_SAR
	tristate "SAR sensor driver"
	default n
	help
	  This is the main file for touchpanel driver for Goodix GT9xx
	  touchscreens.

	  Say Y here if you have a Goodix GT9xx touchscreen connected
	  to your system.

	  If unsure, say N.

	  To compile this driver as a module, choose M here: the
	  module will be called gt9xx_update.
```

## drivers/input/misc/ant_check/Kconfig
```kconfig
#
# SAR Sensor driver
#

config ANT_CHECK
	tristate "ANT check driver"
	default n
	help
	  This is the main file for ANT_CHECK driver.
```

## sound/soc/codecs/tas2562/Kconfig
```kconfig
menuconfig SND_SOC_TAS2562
	tristate "Texas Instruments TAS2562 SmartAmp(R)"

if SND_SOC_TAS2562
config TAS2562_REGMAP
    bool "Use of RegMap API"

config TAS2562_CODEC
    bool "Codec Driver support"

#config TAS2562_MISC
#    bool "Misc Driver support"

#config TAS2558_CODEC

endif # SND_SOC_TAS2562
```
